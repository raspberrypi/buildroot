## configs/raspberrypi-signed-boot_defconfig
```kconfig
BR2_aarch64=y
BR2_ARM_FPU_VFPV4=y
BR2_PACKAGE_HOST_LINUX_HEADERS_CUSTOM_6_6=y
BR2_TOOLCHAIN_BUILDROOT_CXX=y
BR2_CCACHE=y
BR2_TARGET_GENERIC_HOSTNAME="raspberrypi-signed"
BR2_TARGET_GENERIC_ISSUE="Raspberry Pi - signed boot example"
BR2_INIT_SYSTEMD=y
BR2_SYSTEM_BIN_SH_BASH=y
BR2_SYSTEM_DHCP="eth0"
BR2_SYSTEM_DEFAULT_PATH="/bin:/sbin:/usr/bin:/usr/sbin"
BR2_ROOTFS_USERS_TABLES="board/raspberrypi-signed-boot/users"
BR2_ROOTFS_OVERLAY="board/raspberrypi-signed-boot/rootfs-overlay"
BR2_ROOTFS_POST_BUILD_SCRIPT="board/raspberrypi-signed-boot/post-build.sh"
BR2_ROOTFS_POST_IMAGE_SCRIPT="board/raspberrypi-signed-boot/post-image.sh"
BR2_LINUX_KERNEL=y
BR2_LINUX_KERNEL_CUSTOM_GIT=y
BR2_LINUX_KERNEL_CUSTOM_REPO_URL="https://github.com/raspberrypi/linux"
BR2_LINUX_KERNEL_CUSTOM_REPO_VERSION="rpi-6.6.y"
BR2_LINUX_KERNEL_DEFCONFIG="bcm2711"
BR2_LINUX_KERNEL_DTS_SUPPORT=y
BR2_LINUX_KERNEL_INTREE_DTS_NAME="broadcom/bcm2711-rpi-cm4 broadcom/bcm2711-rpi-cm4s broadcom/bcm2711-rpi-4-b broadcom/bcm2711-rpi-400 broadcom/bcm2712-rpi-5-b broadcom/bcm2712-rpi-cm5-cm4io broadcom/bcm2712-rpi-cm5-cm5io broadcom/bcm2712-rpi-cm5l-cm4io broadcom/bcm2712-rpi-cm5l-cm5io broadcom/bcm2712-rpi-500"
BR2_LINUX_KERNEL_NEEDS_HOST_OPENSSL=y
BR2_PACKAGE_XZ=y
BR2_PACKAGE_DOSFSTOOLS=y
BR2_PACKAGE_DOSFSTOOLS_FSCK_FAT=y
BR2_PACKAGE_DOSFSTOOLS_MKFS_FAT=y
BR2_PACKAGE_E2FSPROGS=y
BR2_PACKAGE_E2FSPROGS_DEBUGFS=y
BR2_PACKAGE_MMC_UTILS=y
BR2_PACKAGE_BRCMFMAC_SDIO_FIRMWARE_RPI=y
BR2_PACKAGE_BRCMFMAC_SDIO_FIRMWARE_RPI_BT=y
BR2_PACKAGE_BRCMFMAC_SDIO_FIRMWARE_RPI_WIFI=y
BR2_PACKAGE_RPI_FIRMWARE=y
BR2_PACKAGE_RPI_FIRMWARE_VARIANT_PI4=y
BR2_PACKAGE_RPI_FIRMWARE_CONFIG_FILE="board/raspberrypi-signed-boot/config.txt"
BR2_PACKAGE_RPI_FIRMWARE_CMDLINE_FILE="board/raspberrypi-signed-boot/cmdline.txt"
BR2_PACKAGE_RPI_FIRMWARE_INSTALL_DTB_OVERLAYS_TO_TARGET=y
BR2_PACKAGE_CRYPTSETUP=y
BR2_PACKAGE_DT_UTILS=y
BR2_PACKAGE_DTBOCFG=y
BR2_PACKAGE_FLASHROM=y
BR2_PACKAGE_GVFS=y
BR2_PACKAGE_I2C_TOOLS=y
BR2_PACKAGE_LSSCSI=y
BR2_PACKAGE_NVME=y
BR2_PACKAGE_PCIUTILS=y
BR2_PACKAGE_RASPI_GPIO=y
BR2_PACKAGE_UHUBCTL=y
BR2_PACKAGE_USBUTILS=y
BR2_PACKAGE_CA_CERTIFICATES=y
BR2_PACKAGE_TROUSERS=y
BR2_PACKAGE_SQLITE=y
BR2_PACKAGE_DTC=y
BR2_PACKAGE_DTC_PROGRAMS=y
BR2_PACKAGE_NEWT=y
BR2_PACKAGE_WGET=y
BR2_PACKAGE_WIRELESS_REGDB=y
BR2_PACKAGE_WIRELESS_TOOLS=y
BR2_PACKAGE_WIRELESS_TOOLS_LIB=y
BR2_PACKAGE_WPA_SUPPLICANT=y
BR2_PACKAGE_WPA_SUPPLICANT_AP_SUPPORT=y
BR2_PACKAGE_WPA_SUPPLICANT_WPA3=y
BR2_PACKAGE_WPA_SUPPLICANT_CLI=y
BR2_PACKAGE_WPA_SUPPLICANT_PASSPHRASE=y
BR2_PACKAGE_DASH=y
BR2_PACKAGE_EMBIGGEN_DISK=y
BR2_PACKAGE_TAR=y
BR2_PACKAGE_UTIL_LINUX_MOUNTPOINT=y
BR2_PACKAGE_UTIL_LINUX_PIVOT_ROOT=y
BR2_TARGET_ROOTFS_CPIO=y
BR2_TARGET_ROOTFS_CPIO_ZSTD=y
# BR2_TARGET_ROOTFS_TAR is not set
BR2_PACKAGE_HOST_DOSFSTOOLS=y
BR2_PACKAGE_HOST_E2FSPROGS=y
BR2_PACKAGE_HOST_GENIMAGE=y
BR2_PACKAGE_HOST_KMOD_GZ=y
BR2_PACKAGE_HOST_KMOD_ZSTD=y
BR2_PACKAGE_HOST_KMOD_XZ=y
BR2_PACKAGE_HOST_MTOOLS=y
```

## configs/raspberrypi64-mass-storage-gadget_defconfig
```kconfig
BR2_aarch64=y
BR2_ARM_FPU_VFPV4=y
BR2_PACKAGE_HOST_LINUX_HEADERS_CUSTOM_6_1=y
BR2_TOOLCHAIN_BUILDROOT_CXX=y
BR2_TARGET_GENERIC_HOSTNAME="rpimsg"
BR2_TARGET_GENERIC_ISSUE="Raspberry Pi 64-bit Mass Storage Gadget"
BR2_INIT_SYSTEMD=y
BR2_SYSTEM_DHCP="eth0"
BR2_SYSTEM_DEFAULT_PATH="/bin:/sbin:/usr/bin:/usr/sbin"
BR2_ROOTFS_OVERLAY="board/raspberrypi64-mass-storage-gadget/rootfs_overlay"
BR2_ROOTFS_POST_BUILD_SCRIPT="board/raspberrypi64-mass-storage-gadget/post-build.sh"
BR2_ROOTFS_POST_IMAGE_SCRIPT="board/raspberrypi64-mass-storage-gadget/post-image.sh"
BR2_LINUX_KERNEL=y
BR2_LINUX_KERNEL_CUSTOM_GIT=y
BR2_LINUX_KERNEL_CUSTOM_REPO_URL="https://github.com/raspberrypi/linux"
BR2_LINUX_KERNEL_CUSTOM_REPO_VERSION="rpi-6.1.y"
BR2_LINUX_KERNEL_USE_CUSTOM_CONFIG=y
BR2_LINUX_KERNEL_CUSTOM_CONFIG_FILE=" board/raspberrypi64-mass-storage-gadget/bcm2711_minimal_defconfig"
BR2_LINUX_KERNEL_DTS_SUPPORT=y
BR2_LINUX_KERNEL_INTREE_DTS_NAME="broadcom/bcm2711-rpi-cm4 broadcom/bcm2711-rpi-cm4s broadcom/bcm2711-rpi-4-b broadcom/bcm2711-rpi-400 broadcom/bcm2712-rpi-5-b"
BR2_LINUX_KERNEL_DTB_OVERLAY_SUPPORT=y
BR2_LINUX_KERNEL_NEEDS_HOST_OPENSSL=y
BR2_PACKAGE_XZ=y
BR2_PACKAGE_RPI_FIRMWARE=y
BR2_PACKAGE_RPI_FIRMWARE_VARIANT_PI4_CD=y
BR2_PACKAGE_RPI_FIRMWARE_CONFIG_FILE="board/raspberrypi64-mass-storage-gadget/config.txt"
BR2_PACKAGE_RPI_FIRMWARE_CMDLINE_FILE="board/raspberrypi64-mass-storage-gadget/cmdline.txt"
# BR2_PACKAGE_RPI_FIRMWARE_INSTALL_DTB_OVERLAYS is not set
BR2_PACKAGE_I2C_TOOLS=y
BR2_PACKAGE_LVM2=y
BR2_PACKAGE_RPI_USERLAND=y
BR2_PACKAGE_UHUBCTL=y
BR2_PACKAGE_IFUPDOWN=y
BR2_PACKAGE_TINYSSH=y
# BR2_PACKAGE_SYSTEMD_HWDB is not set
BR2_TARGET_ROOTFS_CPIO=y
BR2_TARGET_ROOTFS_CPIO_ZSTD=y
# BR2_TARGET_ROOTFS_TAR is not set
BR2_PACKAGE_HOST_DOSFSTOOLS=y
BR2_PACKAGE_HOST_E2FSPROGS=y
BR2_PACKAGE_HOST_GENIMAGE=y
BR2_PACKAGE_HOST_KMOD_XZ=y
BR2_PACKAGE_HOST_MTOOLS=y
```

## configs/raspberrypicm4io_initrd_defconfig
```kconfig
BR2_arm=y
BR2_cortex_a72=y
BR2_ARM_FPU_VFPV4=y
BR2_TOOLCHAIN_BUILDROOT_GLIBC=y
BR2_PACKAGE_HOST_LINUX_HEADERS_CUSTOM_5_10=y
BR2_TARGET_GENERIC_HOSTNAME="rpimsg"
BR2_TARGET_GENERIC_ISSUE="Raspberry Pi Mass Storage Gadget"
BR2_ROOTFS_DEVICE_CREATION_DYNAMIC_EUDEV=y
BR2_SYSTEM_DHCP="eth0"
BR2_ROOTFS_OVERLAY="board/raspberrypicm4io-initrd/cm4-msg-overlay"
BR2_ROOTFS_POST_BUILD_SCRIPT="board/raspberrypicm4io-initrd/post-build.sh"
BR2_ROOTFS_POST_IMAGE_SCRIPT="board/raspberrypicm4io-initrd/post-image.sh"
BR2_LINUX_KERNEL=y
BR2_LINUX_KERNEL_CUSTOM_GIT=y
BR2_LINUX_KERNEL_CUSTOM_REPO_URL="https://github.com/raspberrypi/linux"
BR2_LINUX_KERNEL_CUSTOM_REPO_VERSION="rpi-5.10.y"
BR2_LINUX_KERNEL_USE_CUSTOM_CONFIG=y
BR2_LINUX_KERNEL_CUSTOM_CONFIG_FILE="board/raspberrypi/bcm2711_minimal_defconfig"
BR2_LINUX_KERNEL_DTS_SUPPORT=y
BR2_LINUX_KERNEL_INTREE_DTS_NAME="bcm2711-rpi-cm4 bcm2711-rpi-cm4s bcm2711-rpi-4-b bcm2711-rpi-400"
BR2_LINUX_KERNEL_NEEDS_HOST_OPENSSL=y
BR2_PACKAGE_BUSYBOX_SHOW_OTHERS=y
BR2_PACKAGE_RPI_FIRMWARE=y
BR2_PACKAGE_RPI_FIRMWARE_VARIANT_PI4_CD=y
BR2_PACKAGE_RPI_FIRMWARE_CONFIG_FILE="board/raspberrypicm4io-initrd/config_cm4io_initrd.txt"
BR2_PACKAGE_RPI_FIRMWARE_CMDLINE_FILE="board/raspberrypicm4io-initrd/cmdline_cm4io_initrd.txt"
BR2_PACKAGE_I2C_TOOLS=y
BR2_PACKAGE_LVM2=y
BR2_PACKAGE_UHUBCTL=y
BR2_PACKAGE_IFUPDOWN=y
BR2_PACKAGE_TINYSSH=y
BR2_TARGET_ROOTFS_CPIO=y
BR2_TARGET_ROOTFS_CPIO_ZSTD=y
# BR2_TARGET_ROOTFS_TAR is not set
BR2_PACKAGE_HOST_DOSFSTOOLS=y
BR2_PACKAGE_HOST_E2FSPROGS=y
BR2_PACKAGE_HOST_GENIMAGE=y
BR2_PACKAGE_HOST_MTOOLS=y
```

## package/raspberrypi-secure-boot/Config.in
```kconfig
config BR2_PACKAGE_RASPBERRYPI_SECURE_BOOT
	bool "raspberrypi-secure-boot"
	select BR2_PACKAGE_LIBOPENSSL_BIN
	help
	  Raspberry Pi secure-boot tools.

	  https://github.com/raspberrypi/usbboot

config BR2_PACKAGE_RASPBERRYPI_SECURE_BOOT_ADMIN_SSH_LOGIN
	string "admin ssh authorized keys"
	default ""
	depends on BR2_PACKAGE_RASPBERRYPI_SECURE_BOOT

	help
	    For DEBUG, enable SSH login for an admin user by specifying the
	    name of a file that will be copied to /home/admin/.ssh/authorized_keys

config BR2_PACKAGE_RASPBERRYPI_SECURE_BOOT_PRIVATE_KEY
	string "Private key"
	default ""
	depends on BR2_PACKAGE_RASPBERRYPI_SECURE_BOOT

	help
	    The filenmame of the RSA private key in PEM format that will be used
	    to to sign boot.img. If this config is not defined then image will
	    be left unsigned but could be signed at a later date by running
	    the scripts in usbboot/tools manually.
```

## package/raspberrypi-secure-boot/Config.in.host
```kconfig
config BR2_PACKAGE_HOST_RASPBERRYPI_SECURE_BOOT
	bool "host raspberrypi-secure-boot"
	help
	  Raspberry Pi secure-boot signing tools

	  https://github.com/raspberrypi/usbboot
```

## package/rpi-eeprom/Config.in
```kconfig
config BR2_PACKAGE_RPI_EEPROM
	bool "rpi-eeprom"
	select BR2_PACKAGE_OPENSSL_FORCE_LIBOPENSSL
	select BR2_PACKAGE_OPENSSL # runtime
	select BR2_PACKAGE_PYTHON3 # runtime
	select BR2_PACKAGE_PYTHON_PYCRYPTODOMEX # runtime
	help
	  Raspberry Pi tools for accessing the bootloader configuration and customer keys.

	  https://github.com/raspberrypi/rpi-eeprom
```

## package/rpi-eeprom/Config.in.host
```kconfig
config BR2_PACKAGE_HOST_RPI_EEPROM
	bool "host rpi-eeprom"
	select BR2_PACKAGE_HOST_OPENSSL_FORCE_LIBOPENSSL
	select BR2_PACKAGE_HOST_OPENSSL
	select BR2_PACKAGE_HOST_PYTHON3
	select BR2_PACKAGE_HOST_PYTHON_PYCRYPTODOMEX
	help
	  Raspberry Pi tools for updating and signing the bootloader configuration.

	  https://github.com/raspberrypi/rpi-eeprom
```
